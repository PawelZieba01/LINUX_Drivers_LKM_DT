/dts-v1/;
/plugin/;


/ {
        compatible = "brcm,bcm2835";
        //Wyłączenie urządzenia spidev0 - zwolnienie sprzętowego pinu CS0
        fragment@0 {
                target = <&spidev0>;
                __overlay__ {
                        status = "disabled";
                };
        };
        
        fragment@1 {
                target = <&spi0>;
                __overlay__ {
                    status = "okay";
                    #address-cells = <1>;
		    #size-cells = <0>;
                             
                    my_dac: my_dac@0{
                        compatible = "micrpchip,my_dac";
                        status = "okay";
                        reg = <0>;
                        spi-max-frequency = <100000>;
                        spi-bits-per-word = <8>;
                    };
                };
        };
};