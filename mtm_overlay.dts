/dts-v1/;
/plugin/;

/ {
    compatible = "brcm,bcm2835";

    fragment@0 {
        target-path = "/";

        __overlay__ {
            mtm_device {
                compatible = "mtm";
                string_param = "mtm device param";
                int_param = <17>;
            };
        };
    };
};