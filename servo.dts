/dts-v1/;
/plugin/;

/ {
        compatible = "brcm,bcm2835";

        fragment@0 {
                target-path = "/";

                __overlay__ {
                        servo {
                                compatible = "mtm,servo";
                                leds-gpios = <&gpio 22 0>, <&gpio 25 0>, 
                                             <&gpio 5 0>, <&gpio 16 0>;
                                btn-gpio = <&gpio 17 0>;
                        };
                };
        };
};