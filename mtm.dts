/dts-v1/;
/plugin/;

/ {
        compatible = "brcm,bcm2835";

        fragment@0 {
                target-path = "/";

                __overlay__ {
                        mtm_device_1 {
                                compatible = "mtm";
                        };

                        mtm_device_2 {
                                compatible = "mtm";
                        };
                };
        };
};